/ {
     aliases {
             led0 = &myled0;
     };

     leds {
             compatible = "gpio-leds";
             myled0: led_0 {
                     gpios = <&gpioc 13 GPIO_ACTIVE_LOW>;
             };
     };
};